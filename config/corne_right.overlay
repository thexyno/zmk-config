/*
 * Copyright (c) 2020 Pete Johanson
 *
 * SPDX-License-Identifier: MIT
 */

#include "corne.dtsi"

&default_transform {
    col-offset = <6>;
};

&five_column_transform {
    col-offset = <6>;
};

&kscan0 {
    col-gpios
        = <&pro_micro 1 ( GPIO_PULL_DOWN | GPIO_ACTIVE_HIGH)>
        , <&pro_micro 0 ( GPIO_PULL_DOWN | GPIO_ACTIVE_HIGH)>
        , <&pro_micro 3 ( GPIO_PULL_DOWN | GPIO_ACTIVE_HIGH)>
        , <&pro_micro 4 ( GPIO_PULL_DOWN | GPIO_ACTIVE_HIGH)>
        , <&pro_micro 5 ( GPIO_PULL_DOWN | GPIO_ACTIVE_HIGH)>
        , <&pro_micro 6 ( GPIO_PULL_DOWN | GPIO_ACTIVE_HIGH)>
        ;
        row-gpios
            = <&pro_micro 7 (GPIO_ACTIVE_HIGH )>
            , <&pro_micro 8 (GPIO_ACTIVE_HIGH )>
            , <&pro_micro 10 (GPIO_ACTIVE_HIGH )>
            , <&pro_micro 15 (GPIO_ACTIVE_HIGH )>
            ;
};
